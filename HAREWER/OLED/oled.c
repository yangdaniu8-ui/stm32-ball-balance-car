#include "oled.h"
#include "delay.h"
#include <stdarg.h>
#include <string.h>
#include <stdio.h>

/************************************************************
 * 6x8  ASCII 点阵字库（' ' ~ '~'，共 95 个字符）
 ************************************************************/
static const u8 F6x8[][6] = {
    { 0x00, 0x00, 0x00, 0x00, 0x00, 0x00 },   /* sp (0x20) */
    { 0x00, 0x00, 0x00, 0x2f, 0x00, 0x00 },   /* !  */
    { 0x00, 0x00, 0x07, 0x00, 0x07, 0x00 },   /* "  */
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    { 0x00, 0x10, 0x08, 0x08, 0x10, 0x08 },   /* ~  */
};

/************************************************************
 * 8x16 ASCII 点阵字库（' ' ~ '~'，共 95 个字符）
 ************************************************************/
static const u8 F8x16[][16] = {
    { 0x00,0x00,0x00,0x00,0x00,0x00,0x00,0x00,0x00,0x00,0x00,0x00,0x00,0x00,0x00,0x00 }, /* sp */
    { 0x00,0x00,0x00,0xF8,0x00,0x00,0x00,0x00,0x00,0x00,0x00,0x33,0x30,0x00,0x00,0x00 }, /* !  */
    { 0x00,0x10,0x0C,0x06,0x10,0x0C,0x06,0x00,0x00,0x00,0x00,0x00,0x00,0x00,0x00,0x00 }, /* "  */
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    { 0x00,0x06,0x01,0x01,0x02,0x02,0x04,0x04,0x00,0x00,0x00,0x00,0x00,0x00,0x00,0x00 }, /* ~  */
};

/* 全局帧缓冲区 */
static u8 OLED_FrameBuf[OLED_WIDTH * OLED_PAGES];  /* 128 * 8 = 1024 bytes */

/**************************************************************************
 * 函数功能：I2C2 初始化（PB10=SCL, PB11=SDA）
 *          I2C 速率：400kHz (Fast Mode)
 **************************************************************************/
static void OLED_I2C_Init(void)
{
    GPIO_InitTypeDef GPIO_InitStructure;
    I2C_InitTypeDef I2C_InitStructure;

    /* 使能时钟 */
    RCC_APB1PeriphClockCmd(RCC_APB1Periph_I2C2, ENABLE);
    RCC_APB2PeriphClockCmd(RCC_APB2Periph_GPIOB, ENABLE);

    /* PB10(SCL), PB11(SDA) — 开漏复用输出 */
    GPIO_InitStructure.GPIO_Pin   = GPIO_Pin_10 | GPIO_Pin_11;
    GPIO_InitStructure.GPIO_Mode  = GPIO_Mode_AF_OD;
    GPIO_InitStructure.GPIO_Speed = GPIO_Speed_50MHz;
    GPIO_Init(GPIOB, &GPIO_InitStructure);

    /* I2C 配置 */
    I2C_DeInit(I2C2);
    I2C_InitStructure.I2C_Mode              = I2C_Mode_I2C;
    I2C_InitStructure.I2C_DutyCycle         = I2C_DutyCycle_2;       /* Fast Mode 2:1 */
    I2C_InitStructure.I2C_OwnAddress1       = 0x00;
    I2C_InitStructure.I2C_Ack               = I2C_Ack_Enable;
    I2C_InitStructure.I2C_AcknowledgedAddress = I2C_AcknowledgedAddress_7bit;
    I2C_InitStructure.I2C_ClockSpeed        = 400000;                /* 400kHz */
    I2C_Init(I2C2, &I2C_InitStructure);

    I2C_Cmd(I2C2, ENABLE);
}

/* I2C 超时计数器上限（约 100ms @ 72MHz） */
#define I2C_TIMEOUT     1000000

/* OLED 通信状态 */
static u8 OLED_Ready    = 0;   /* 0=未初始化/需恢复, 1=正常 */
static u8 OLED_Recover  = 0;   /* 1=下次刷新前先恢复 */

/**************************************************************************
 * 函数功能：I2C 总线恢复 — 复位 I2C 外设，解除 SDA 被拉死
 *          不重新发送 OLED 初始化序列，仅复位 I2C 控制器
 **************************************************************************/
static void OLED_I2C_Reset(void)
{
    /* 关闭并复位 I2C2 */
    I2C_Cmd(I2C2, DISABLE);
    RCC_APB1PeriphResetCmd(RCC_APB1Periph_I2C2, ENABLE);
    { volatile u32 dly = 720; while (dly--); }   /* ~10µs */
    RCC_APB1PeriphResetCmd(RCC_APB1Periph_I2C2, DISABLE);

    /* 重新初始化 I2C2 */
    {
        GPIO_InitTypeDef GPIO_InitStructure;
        I2C_InitTypeDef I2C_InitStructure;

        RCC_APB1PeriphClockCmd(RCC_APB1Periph_I2C2, ENABLE);
        RCC_APB2PeriphClockCmd(RCC_APB2Periph_GPIOB, ENABLE);

        GPIO_InitStructure.GPIO_Pin   = GPIO_Pin_10 | GPIO_Pin_11;
        GPIO_InitStructure.GPIO_Mode  = GPIO_Mode_AF_OD;
        GPIO_InitStructure.GPIO_Speed = GPIO_Speed_50MHz;
        GPIO_Init(GPIOB, &GPIO_InitStructure);

        I2C_DeInit(I2C2);
        I2C_InitStructure.I2C_Mode               = I2C_Mode_I2C;
        I2C_InitStructure.I2C_DutyCycle          = I2C_DutyCycle_2;
        I2C_InitStructure.I2C_OwnAddress1        = 0x00;
        I2C_InitStructure.I2C_Ack                = I2C_Ack_Enable;
        I2C_InitStructure.I2C_AcknowledgedAddress = I2C_AcknowledgedAddress_7bit;
        I2C_InitStructure.I2C_ClockSpeed         = 400000;
        I2C_Init(I2C2, &I2C_InitStructure);

        I2C_Cmd(I2C2, ENABLE);
    }
    OLED_Ready = 1;
}

/**************************************************************************
 * 函数功能：I2C2 发送一个字节（带超时）
 * 返回值  ：0=成功, 1=超时
 **************************************************************************/
static u8 I2C2_WriteByte(u8 data)
{
    u32 timeout = I2C_TIMEOUT;

    /* 等待发送缓冲区空 */
    while (I2C_GetFlagStatus(I2C2, I2C_FLAG_TXE) == RESET)
    {
        if (--timeout == 0) return 1;
    }
    I2C_SendData(I2C2, data);

    /* 等待字节发送完成 */
    timeout = I2C_TIMEOUT;
    while (I2C_GetFlagStatus(I2C2, I2C_FLAG_BTF) == RESET)
    {
        if (--timeout == 0) return 1;
    }
    return 0;
}

/**************************************************************************
 * 函数功能：向 SSD1306 发送命令（带超时保护）
 *          如果 OLED 未连接，超时后自动跳过，不会卡死系统
 **************************************************************************/
static void OLED_WriteCmd(u8 cmd)
{
    u32 timeout;

    if (!OLED_Ready) return;

    timeout = I2C_TIMEOUT;
    while (I2C_GetFlagStatus(I2C2, I2C_FLAG_BUSY))
    {
        if (--timeout == 0) { OLED_Recover = 1; return; }
    }

    I2C_GenerateSTART(I2C2, ENABLE);
    timeout = I2C_TIMEOUT;
    while (!I2C_CheckEvent(I2C2, I2C_EVENT_MASTER_MODE_SELECT))
    {
        if (--timeout == 0) { OLED_Recover = 1; return; }
    }

    I2C_Send7bitAddress(I2C2, OLED_I2C_ADDR, I2C_Direction_Transmitter);
    timeout = I2C_TIMEOUT;
    while (!I2C_CheckEvent(I2C2, I2C_EVENT_MASTER_TRANSMITTER_MODE_SELECTED))
    {
        if (I2C_GetFlagStatus(I2C2, I2C_FLAG_AF))
        {
            I2C_ClearFlag(I2C2, I2C_FLAG_AF);
            I2C_GenerateSTOP(I2C2, ENABLE);
            OLED_Recover = 1;
            return;
        }
        if (--timeout == 0) { OLED_Recover = 1; return; }
    }

    if (I2C2_WriteByte(0x00)) { OLED_Recover = 1; return; }
    if (I2C2_WriteByte(cmd))  { OLED_Recover = 1; return; }

    I2C_GenerateSTOP(I2C2, ENABLE);
}

/**************************************************************************
 * 函数功能：向 SSD1306 发送数据（带超时保护）
 **************************************************************************/
static void OLED_WriteData(u8 data)
{
    u32 timeout;

    if (!OLED_Ready) return;

    timeout = I2C_TIMEOUT;
    while (I2C_GetFlagStatus(I2C2, I2C_FLAG_BUSY))
    {
        if (--timeout == 0) { OLED_Recover = 1; return; }
    }

    I2C_GenerateSTART(I2C2, ENABLE);
    timeout = I2C_TIMEOUT;
    while (!I2C_CheckEvent(I2C2, I2C_EVENT_MASTER_MODE_SELECT))
    {
        if (--timeout == 0) { OLED_Recover = 1; return; }
    }

    I2C_Send7bitAddress(I2C2, OLED_I2C_ADDR, I2C_Direction_Transmitter);
    timeout = I2C_TIMEOUT;
    while (!I2C_CheckEvent(I2C2, I2C_EVENT_MASTER_TRANSMITTER_MODE_SELECTED))
    {
        if (I2C_GetFlagStatus(I2C2, I2C_FLAG_AF))
        {
            I2C_ClearFlag(I2C2, I2C_FLAG_AF);
            I2C_GenerateSTOP(I2C2, ENABLE);
            OLED_Recover = 1;
            return;
        }
        if (--timeout == 0) { OLED_Recover = 1; return; }
    }

    if (I2C2_WriteByte(0x40)) { OLED_Recover = 1; return; }
    if (I2C2_WriteByte(data))  { OLED_Recover = 1; return; }

    I2C_GenerateSTOP(I2C2, ENABLE);
}

/**************************************************************************
 * 函数功能：OLED 初始化 — SSD1306 配置序列
 **************************************************************************/
void OLED_Init(void)
{
    /* 先初始化 I2C */
    OLED_I2C_Init();
    OLED_Ready = 1;     /* 先假设可用，探测失败再清除 */

    /* 等待 SSD1306 上电稳定 */
    delay_ms(100);

    /* === SSD1306 初始化命令序列 === */
    OLED_WriteCmd(0xAE);    /* 关闭显示 */

    OLED_WriteCmd(0x20);    /* 设置内存地址模式 */
    OLED_WriteCmd(0x00);    /* 水平寻址模式 */

    OLED_WriteCmd(0xB0);    /* 设置页起始地址 (Page 0) */

    OLED_WriteCmd(0xC8);    /* COM 扫描方向：从 COM63 到 COM0 */

    OLED_WriteCmd(0x00);    /* 列低 4 位 */
    OLED_WriteCmd(0x10);    /* 列高 4 位 */

    OLED_WriteCmd(0x40);    /* 显示起始行 = 0 */

    OLED_WriteCmd(0x81);    /* 设置对比度 */
    OLED_WriteCmd(0xCF);    /* 对比度值 (0~255) */

    OLED_WriteCmd(0xA1);    /* 段重映射：列 127 映射到 SEG0 */

    OLED_WriteCmd(0xA6);    /* 正常显示（非反转） */

    OLED_WriteCmd(0xA8);    /* 设置多路复用比 */
    OLED_WriteCmd(0x3F);    /* 64 COM */

    OLED_WriteCmd(0xA4);    /* 全屏显示关闭（正常模式） */

    OLED_WriteCmd(0xD3);    /* 设置显示偏移 */
    OLED_WriteCmd(0x00);    /* 偏移 = 0 */

    OLED_WriteCmd(0xD5);    /* 设置显示时钟分频 / 振荡器频率 */
    OLED_WriteCmd(0x80);    /* 默认值 */

    OLED_WriteCmd(0xD9);    /* 设置预充电周期 */
    OLED_WriteCmd(0xF1);    /* Phase1=15, Phase2=1 */

    OLED_WriteCmd(0xDA);    /* 设置 COM 引脚硬件配置 */
    OLED_WriteCmd(0x12);    /* 顺序模式，允许左右反转 */

    OLED_WriteCmd(0xDB);    /* 设置 VCOMH 取消选择电平 */
    OLED_WriteCmd(0x40);    /* ~0.77 x VCC */

    OLED_WriteCmd(0x8D);    /* 电荷泵设置 */
    OLED_WriteCmd(0x14);    /* 使能电荷泵 */

    OLED_WriteCmd(0xAF);    /* 开启显示 */

    /* 清零帧缓冲区 */
    OLED_Clear();
    OLED_Refresh();
}

/**************************************************************************
 * 函数功能：清除帧缓冲区（全部写 0x00）
 **************************************************************************/
void OLED_Clear(void)
{
    u16 i;
    for (i = 0; i < sizeof(OLED_FrameBuf); i++)
    {
        OLED_FrameBuf[i] = 0x00;
    }
}

/**************************************************************************
 * 函数功能：将帧缓冲区刷新到 SSD1306
 *          使用水平寻址模式，一次性写入全部 1024 字节
 **************************************************************************/
void OLED_Refresh(void)
{
    u16 i;

    /* 通信出错后自动恢复 I2C 总线 */
    if (OLED_Recover)
    {
        OLED_Recover = 0;
        OLED_I2C_Reset();
        /* 重发 SSD1306 初始化序列 */
        OLED_WriteCmd(0xAE);
        OLED_WriteCmd(0x20);  OLED_WriteCmd(0x00);
        OLED_WriteCmd(0xB0);
        OLED_WriteCmd(0xC8);
        OLED_WriteCmd(0x00);  OLED_WriteCmd(0x10);
        OLED_WriteCmd(0x40);
        OLED_WriteCmd(0x81);  OLED_WriteCmd(0xCF);
        OLED_WriteCmd(0xA1);
        OLED_WriteCmd(0xA6);
        OLED_WriteCmd(0xA8);  OLED_WriteCmd(0x3F);
        OLED_WriteCmd(0xA4);
        OLED_WriteCmd(0xD3);  OLED_WriteCmd(0x00);
        OLED_WriteCmd(0xD5);  OLED_WriteCmd(0x80);
        OLED_WriteCmd(0xD9);  OLED_WriteCmd(0xF1);
        OLED_WriteCmd(0xDA);  OLED_WriteCmd(0x12);
        OLED_WriteCmd(0xDB);  OLED_WriteCmd(0x40);
        OLED_WriteCmd(0x8D);  OLED_WriteCmd(0x14);
        OLED_WriteCmd(0xAF);
    }

    if (!OLED_Ready) return;

    /* 设置列地址范围 0~127 */
    OLED_WriteCmd(0x21);
    OLED_WriteCmd(0x00);
    OLED_WriteCmd(0x7F);

    /* 设置页地址范围 0~7 */
    OLED_WriteCmd(0x22);
    OLED_WriteCmd(0x00);
    OLED_WriteCmd(0x07);

    /* 批量写入数据 */
    for (i = 0; i < sizeof(OLED_FrameBuf); i++)
    {
        OLED_WriteData(OLED_FrameBuf[i]);
    }
}

/**************************************************************************
 * 函数功能：在帧缓冲区中绘制一个点
 * 入口参数：x — 横坐标 (0~127)
 *           y — 纵坐标 (0~63)
 *           mode — 1=点亮, 0=熄灭
 **************************************************************************/
void OLED_DrawPoint(u8 x, u8 y, u8 mode)
{
    u8 page, bit;

    if (x >= OLED_WIDTH || y >= OLED_HEIGHT)
        return;

    page = y / 8;           /* 所在页 (0~7) */
    bit  = y % 8;           /* 页内位偏移 */

    if (mode)
        OLED_FrameBuf[page * OLED_WIDTH + x] |= (1 << bit);
    else
        OLED_FrameBuf[page * OLED_WIDTH + x] &= ~(1 << bit);
}

/**************************************************************************
 * 函数功能：在指定位置显示一个字符
 * 入口参数：x — 横坐标
 *           y — 纵坐标
 *           ch — 字符
 *           size — 字号：12=6x8, 16=8x16
 **************************************************************************/
void OLED_ShowChar(u8 x, u8 y, u8 ch, u8 size)
{
    u8 i, j;
    u8 temp;

    /* 只支持可打印 ASCII */
    if (ch < ' ' || ch > '~')
        ch = ' ';

    ch -= ' ';  /* 偏移到字库索引 */

    if (size == 12)
    {
        /* 6x8 字体 */
        for (i = 0; i < 6; i++)
        {
            temp = F6x8[ch][i];
            for (j = 0; j < 8; j++)
            {
                if (temp & (1 << j))
                    OLED_DrawPoint(x + i, y + j, 1);
                else
                    OLED_DrawPoint(x + i, y + j, 0);
            }
        }
    }
    else if (size == 16)
    {
        /* 8x16 字体 — 上半部分 */
        for (i = 0; i < 8; i++)
        {
            temp = F8x16[ch][i];
            for (j = 0; j < 8; j++)
            {
                if (temp & (1 << j))
                    OLED_DrawPoint(x + i, y + j, 1);
                else
                    OLED_DrawPoint(x + i, y + j, 0);
            }
        }
        /* 8x16 字体 — 下半部分 */
        for (i = 0; i < 8; i++)
        {
            temp = F8x16[ch][i + 8];
            for (j = 0; j < 8; j++)
            {
                if (temp & (1 << j))
                    OLED_DrawPoint(x + i, y + j + 8, 1);
                else
                    OLED_DrawPoint(x + i, y + j + 8, 0);
            }
        }
    }
}

/**************************************************************************
 * 函数功能：显示字符串
 * 入口参数：x, y — 起始坐标
 *           str — 字符串指针
 *           size — 字号 12 或 16
 **************************************************************************/
void OLED_ShowString(u8 x, u8 y, const char *str, u8 size)
{
    u8 charWidth = (size == 16) ? 8 : 6;

    while (*str)
    {
        /* 自动换行 */
        if (x + charWidth > OLED_WIDTH)
        {
            x = 0;
            y += (size == 16) ? 16 : 8;
        }

        /* 超出屏幕高度则停止 */
        if (y + ((size == 16) ? 16 : 8) > OLED_HEIGHT)
            break;

        OLED_ShowChar(x, y, *str, size);
        x += charWidth;
        str++;
    }
}

/**************************************************************************
 * 函数功能：显示数字
 * 入口参数：x, y — 位置
 *           num — 数字
 *           len — 显示位数（不足补空格）
 *           size — 字号
 **************************************************************************/
void OLED_ShowNum(u8 x, u8 y, int num, u8 len, u8 size)
{
    char buf[12];
    u8 i, charWidth = (size == 16) ? 8 : 6;

    /* 转换为字符串 */
    for (i = 0; i < len; i++)
    {
        buf[len - 1 - i] = '0' + (num % 10);
        num /= 10;
    }
    buf[len] = '\0';

    /* 显示 */
    for (i = 0; i < len; i++)
    {
        OLED_ShowChar(x + i * charWidth, y, buf[i], size);
    }
}

/* 简单的幂函数：10^n */
static int pow10(u8 n)
{
    int result = 1;
    while (n--) result *= 10;
    return result;
}

/**************************************************************************
 * 函数功能：显示浮点数
 * 入口参数：x, y — 位置
 *           num — 浮点数
 *           intLen — 整数部分位数
 *           decLen — 小数部分位数
 *           size — 字号
 **************************************************************************/
void OLED_ShowFloat(u8 x, u8 y, float num, u8 intLen, u8 decLen, u8 size)
{
    char buf[16];
    int intPart, decPart;
    u8 i, pos = 0;
    u8 charWidth = (size == 16) ? 8 : 6;

    /* 处理负数 */
    if (num < 0)
    {
        OLED_ShowChar(x, y, '-', size);
        x += charWidth;
        num = -num;
    }

    intPart = (int)num;
    decPart = (int)((num - intPart) * pow10(decLen) + 0.5f);

    /* 整数部分 */
    for (i = 0; i < intLen; i++)
    {
        buf[intLen - 1 - i] = '0' + (intPart % 10);
        intPart /= 10;
    }
    for (i = 0; i < intLen; i++)
    {
        OLED_ShowChar(x + pos * charWidth, y, buf[i], size);
        pos++;
    }

    /* 小数点 */
    if (decLen > 0)
    {
        OLED_ShowChar(x + pos * charWidth, y, '.', size);
        pos++;

        /* 小数部分 */
        for (i = 0; i < decLen; i++)
        {
            buf[decLen - 1 - i] = '0' + (decPart % 10);
            decPart /= 10;
        }
        for (i = 0; i < decLen; i++)
        {
            OLED_ShowChar(x + pos * charWidth, y, buf[i], size);
            pos++;
        }
    }
}

/**************************************************************************
 * 函数功能：格式化显示（类似 printf）
 * 入口参数：x, y — 位置
 *           size — 字号
 *           fmt — 格式化字符串（仅支持 %d, %f, %s）
 *
 * 注意：为简化代码，这里提供一个基础实现。
 *       如需要完整的 printf 功能，建议使用 sprintf + OLED_ShowString。
 **************************************************************************/
void OLED_Printf(u8 x, u8 y, u8 size, const char *fmt, ...)
{
    char buf[64];
    va_list args;

    va_start(args, fmt);
    vsnprintf(buf, sizeof(buf), fmt, args);
    va_end(args);

    OLED_ShowString(x, y, buf, size);
}
